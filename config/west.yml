## config/west.yml
```yaml
manifest:
  remotes:
    - name: AakashDabas
      url-base: https://github.com/AakashDabas
  projects:
    - name: zmk
      remote: AakashDabas
      revision: main
      import: app/west.yml
  self:
    path: config
```
